#include <FastLED.h>
#include <WiFi.h>
#include <AsyncTCP.h>
#include <ESPAsyncWebServer.h>

const char* ssid = "G3";
const char* password = "12345678910";

// Pin configuration
const int DATA_PIN = 13;
const int NUM_PIXELS = 30;
int wait = 8 ;

int messageLength = 0;
int currentPosition = 0;
int hallEffectPin = 14;  // Pin connected to the hall effect sensor

CRGB leds[NUM_PIXELS];

int brightnessLevel = 128;

int previousBrightnessLevel = brightnessLevel;


String message="";

int aData[16][16] = {
  {0, 0, 0, 0, 0, 0, 0, 0, 0, 0, 0, 0, 0, 0, 0, 0},
  {0, 0, 0, 0, 0, 0, 0, 0, 0, 0, 0, 0, 0, 0, 0, 0},
  {0, 0, 0, 0, 0, 0, 0, 0, 0, 0, 0, 0, 0, 0, 0, 0},
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  {0, 0, 1, 1, 1, 1, 1, 1, 1, 1, 1, 1, 1, 1, 1, 1}
};

int bData[16][16] = {
  {0, 0, 0, 0, 0, 0, 0, 0, 0, 0, 0, 0, 0, 0, 0, 0},
  {0, 0, 0, 0, 0, 0, 0, 0, 0, 0, 0, 0, 0, 0, 0, 0},
  {0, 0, 0, 0, 0, 0, 0, 0, 0, 0, 0, 0, 0, 0, 0, 0},
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  {1, 1, 1, 1, 1, 1, 1, 1, 1, 1, 1, 1, 1, 1, 1, 1}


};

int cData[16][16] = {
  {0, 0, 0, 0, 0, 0, 0, 0, 0, 0, 0, 0, 0, 0, 0, 0},
  {0, 0, 0, 0, 0, 0, 0, 0, 0, 0, 0, 0, 0, 0, 0, 0},
  {0, 0, 0, 0, 0, 0, 0, 0, 0, 0, 0, 0, 0, 0, 0, 0},
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  {0, 0, 0, 1, 1, 1, 1, 1, 1, 1, 1, 1, 1, 0, 0, 0}
};

int dData[16][16] = {
  {0, 0, 0, 0, 0, 0, 0, 0, 0, 0, 0, 0, 0, 0, 0, 0},
  {0, 0, 0, 0, 0, 0, 0, 0, 0, 0, 0, 0, 0, 0, 0, 0},
  {0, 0, 0, 0, 0, 0, 0, 0, 0, 0, 0, 0, 0, 0, 0, 0},
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  {1, 1, 1, 1, 1, 1, 1, 1, 1, 1, 1, 1, 1, 1, 1, 1}
};

int eData[16][16] = {
  {0, 0, 0, 0, 0, 0, 0, 0, 0, 0, 0, 0, 0, 0, 0, 0},
  {0, 0, 0, 0, 0, 0, 0, 0, 0, 0, 0, 0, 0, 0, 0, 0},
  {0, 0, 0, 0, 0, 0, 0, 0, 0, 0, 0, 0, 0, 0, 0, 0},
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  {1, 1, 1, 1, 1, 1, 1, 1, 1, 1, 1, 1, 1, 1, 1, 1}
};

int fData[16][16] = {
  {0, 0, 0, 0, 0, 0, 0, 0, 0, 0, 0, 0, 0, 0, 0, 0},
  {0, 0, 0, 0, 0, 0, 0, 0, 0, 0, 0, 0, 0, 0, 0, 0},
  {0, 0, 0, 0, 0, 0, 0, 0, 0, 0, 0, 0, 0, 0, 0, 0},
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  {1, 1, 1, 1, 1, 1, 1, 1, 1, 1, 1, 1, 1, 1, 1, 1}
};

int gData[16][16] = {
  {0, 0, 0, 0, 0, 0, 0, 0, 0, 0, 0, 0, 0, 0, 0, 0},
  {0, 0, 0, 0, 0, 0, 0, 0, 0, 0, 0, 0, 0, 0, 0, 0},
  {0, 0, 0, 0, 0, 0, 0, 0, 0, 0, 0, 0, 0, 0, 0, 0},
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  {1, 1, 1, 1, 1, 1, 1, 1, 1, 1, 1, 1, 1, 1, 1, 1}
};

int hData[16][16] = {
  {0, 0, 0, 0, 0, 0, 0, 0, 0, 0, 0, 0, 0, 0, 0, 0},
  {0, 0, 0, 0, 0, 0, 0, 0, 0, 0, 0, 0, 0, 0, 0, 0},
  {0, 0, 0, 0, 0, 0, 0, 0, 0, 0, 0, 0, 0, 0, 0, 0},
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  {1, 1, 1, 1, 1, 1, 1, 1, 1, 1, 1, 1, 1, 1, 1, 1}
};

int iData[16][16] = {
  {0, 0, 0, 0, 0, 0, 0, 0, 0, 0, 0, 0, 0, 0, 0, 0},
  {0, 0, 0, 0, 0, 0, 0, 0, 0, 0, 0, 0, 0, 0, 0, 0},
  {0, 0, 0, 0, 0, 0, 0, 0, 0, 0, 0, 0, 0, 0, 0, 0},
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  {1, 1, 1, 0, 0, 0, 0, 0, 0, 0, 0, 0, 0, 1, 1, 1}
};

int jData[16][16] = {
  {0, 0, 0, 0, 0, 0, 0, 0, 0, 0, 0, 0, 0, 0, 0, 0},
  {0, 0, 0, 0, 0, 0, 0, 0, 0, 0, 0, 0, 0, 0, 0, 0},
  {0, 0, 0, 0, 0, 0, 0, 0, 0, 0, 0, 0, 0, 0, 0, 0},
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  {1, 1, 1, 0, 0, 0, 0, 0, 0, 0, 0, 1, 1, 1, 1, 0}
};

int kData[16][16] = {
  {0, 0, 0, 0, 0, 0, 0, 0, 0, 0, 0, 0, 0, 0, 0, 0},
  {0, 0, 0, 0, 0, 0, 0, 0, 0, 0, 0, 0, 0, 0, 0, 0},
  {0, 0, 0, 0, 0, 0, 0, 0, 0, 0, 0, 0, 0, 0, 0, 0},
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  {1, 1, 1, 1, 1, 1, 1, 1, 1, 1, 1, 1, 1, 1, 1, 1}
};


int lData[16][16] = {
  {0, 0, 0, 0, 0, 0, 0, 0, 0, 0, 0, 0, 0, 0, 0, 0},
  {0, 0, 0, 0, 0, 0, 0, 0, 0, 0, 0, 0, 0, 0, 0, 0},
  {0, 0, 0, 0, 0, 0, 0, 0, 0, 0, 0, 0, 0, 0, 0, 0},
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  {1, 1, 1, 1, 1, 1, 1, 1, 1, 1, 1, 1, 1, 1, 1, 1}
};

int mData[16][16] = {
  {0, 0, 0, 0, 0, 0, 0, 0, 0, 0, 0, 0, 0, 0, 0, 0},
  {0, 0, 0, 0, 0, 0, 0, 0, 0, 0, 0, 0, 0, 0, 0, 0},
  {0, 0, 0, 0, 0, 0, 0, 0, 0, 0, 0, 0, 0, 0, 0, 0},
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  {1, 1, 1, 1, 1, 1, 1, 1, 1, 1, 1, 1, 1, 1, 1, 1}
};


int nData[16][16] = {
  {0, 0, 0, 0, 0, 0, 0, 0, 0, 0, 0, 0, 0, 0, 0, 0},
  {0, 0, 0, 0, 0, 0, 0, 0, 0, 0, 0, 0, 0, 0, 0, 0},
  {0, 0, 0, 0, 0, 0, 0, 0, 0, 0, 0, 0, 0, 0, 0, 0},
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  {1, 1, 1, 1, 1, 1, 1, 1, 1, 1, 1, 1, 1, 1, 1, 1}
};

int oData[16][16] = {
  {0, 0, 0, 0, 0, 0, 0, 0, 0, 0, 0, 0, 0, 0, 0, 0},
  {0, 0, 0, 0, 0, 0, 0, 0, 0, 0, 0, 0, 0, 0, 0, 0},
  {0, 0, 0, 0, 0, 0, 0, 0, 0, 0, 0, 0, 0, 0, 0, 0},
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  {0, 0, 0, 1, 1, 1, 1, 1, 1, 1, 1, 1, 1, 0, 0, 0}
};


int pData[16][16] = {
  {0, 0, 0, 0, 0, 0, 0, 0, 0, 0, 0, 0, 0, 0, 0, 0},
  {0, 0, 0, 0, 0, 0, 0, 0, 0, 0, 0, 0, 0, 0, 0, 0},
  {0, 0, 0, 0, 0, 0, 0, 0, 0, 0, 0, 0, 0, 0, 0, 0},
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  {1, 1, 1, 1, 1, 1, 1, 1, 1, 1, 1, 1, 1, 1, 1, 1}
};


int qData[16][16] = {
  {0, 0, 0, 0, 0, 0, 0, 0, 0, 0, 0, 0, 0, 0, 0, 0},
  {0, 0, 0, 0, 0, 0, 0, 0, 0, 0, 0, 0, 0, 0, 0, 0},
  {0, 0, 0, 0, 0, 0, 0, 0, 0, 0, 0, 0, 0, 0, 0, 0},
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  {0, 0, 1, 1, 1, 1, 1, 1, 1, 1, 1, 1, 1, 1, 0, 0}
};


int rData[16][16] = {
  {0, 0, 0, 0, 0, 0, 0, 0, 0, 0, 0, 0, 0, 0, 0, 0},
  {0, 0, 0, 0, 0, 0, 0, 0, 0, 0, 0, 0, 0, 0, 0, 0},
  {0, 0, 0, 0, 0, 0, 0, 0, 0, 0, 0, 0, 0, 0, 0, 0},
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  {1, 1, 1, 1, 1, 1, 1, 1, 1, 1, 1, 1, 1, 1, 1, 1}
};


int sData[16][16] = {
  {0, 0, 0, 0, 0, 0, 0, 0, 0, 0, 0, 0, 0, 0, 0, 0},
  {0, 0, 0, 0, 0, 0, 0, 0, 0, 0, 0, 0, 0, 0, 0, 0},
  {0, 0, 0, 0, 0, 0, 0, 0, 0, 0, 0, 0, 0, 0, 0, 0},
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  {0, 0, 1, 1, 1, 1, 0, 0, 0, 0, 0, 0, 0, 1, 1, 1}
};

int tData[16][16] = {

  {0, 0, 0, 0, 0, 0, 0, 0, 0, 0, 0, 0, 0, 0, 0, 0},
  {0, 0, 0, 0, 0, 0, 0, 0, 0, 0, 0, 0, 0, 0, 0, 0},
  {0, 0, 0, 0, 0, 0, 0, 0, 0, 0, 0, 0, 0, 0, 0, 0},
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  {1, 1, 0, 0, 0, 0, 0, 0, 0, 0, 0, 0, 0, 0, 0, 0}
};

int uData[16][16] = {
  {0, 0, 0, 0, 0, 0, 0, 0, 0, 0, 0, 0, 0, 0, 0, 0},
  {0, 0, 0, 0, 0, 0, 0, 0, 0, 0, 0, 0, 0, 0, 0, 0},
  {0, 0, 0, 0, 0, 0, 0, 0, 0, 0, 0, 0, 0, 0, 0, 0},
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  {1, 1, 1, 1, 1, 1, 1, 1, 1, 1, 1, 1, 1, 0, 0, 0}
};


int vData[16][16] = {
  {0, 0, 0, 0, 0, 0, 0, 0, 0, 0, 0, 0, 0, 0, 0, 0},
  {0, 0, 0, 0, 0, 0, 0, 0, 0, 0, 0, 0, 0, 0, 0, 0},
  {0, 0, 0, 0, 0, 0, 0, 0, 0, 0, 0, 0, 0, 0, 0, 0},
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  {1, 1, 1, 1, 1, 1, 1, 1, 1, 1, 1, 0, 0, 0, 0, 0}
};

int wData[16][16] = {
  {0, 0, 0, 0, 0, 0, 0, 0, 0, 0, 0, 0, 0, 0, 0, 0},
  {0, 0, 0, 0, 0, 0, 0, 0, 0, 0, 0, 0, 0, 0, 0, 0},
  {0, 0, 0, 0, 0, 0, 0, 0, 0, 0, 0, 0, 0, 0, 0, 0},
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  {1, 1, 1, 1, 1, 1, 1, 1, 1, 1, 1, 1, 1, 1, 1, 1}
};

int xData[16][16] = {
  {0, 0, 0, 0, 0, 0, 0, 0, 0, 0, 0, 0, 0, 0, 0, 0},
  {0, 0, 0, 0, 0, 0, 0, 0, 0, 0, 0, 0, 0, 0, 0, 0},
  {0, 0, 0, 0, 0, 0, 0, 0, 0, 0, 0, 0, 0, 0, 0, 0},
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  {1, 1, 1, 0, 0, 0, 0, 0, 0, 0, 0, 0, 0, 1, 1, 1}
};

int yData[16][16] = {
  {0, 0, 0, 0, 0, 0, 0, 0, 0, 0, 0, 0, 0, 0, 0, 0},
  {0, 0, 0, 0, 0, 0, 0, 0, 0, 0, 0, 0, 0, 0, 0, 0},
  {0, 0, 0, 0, 0, 0, 0, 0, 0, 0, 0, 0, 0, 0, 0, 0},
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  {1, 1, 1, 0, 0, 0, 0, 0, 0, 0, 0, 0, 0, 0, 0, 0}
};


int zData[16][16] = {
  {0, 0, 0, 0, 0, 0, 0, 0, 0, 0, 0, 0, 0, 0, 0, 0},
  {0, 0, 0, 0, 0, 0, 0, 0, 0, 0, 0, 0, 0, 0, 0, 0},
  {0, 0, 0, 0, 0, 0, 0, 0, 0, 0, 0, 0, 0, 0, 0, 0},
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  {1, 1, 1, 0, 0, 0, 0, 0, 0, 0, 1, 1, 1, 1, 1, 1}
};

int spData[16][16] = {
  {0, 0, 0, 0, 0, 0, 0, 0, 0, 0, 0, 0, 0, 0, 0, 0},
  {0, 0, 0, 0, 0, 0, 0, 0, 0, 0, 0, 0, 0, 0, 0, 0},
  {0, 0, 0, 0, 0, 0, 0, 0, 0, 0, 0, 0, 0, 0, 0, 0},
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  {0, 0, 0, 0, 0, 0, 0, 0, 0, 0, 0, 0, 0, 0, 0, 0}
};

AsyncWebServer server(80);

void handleRoot(AsyncWebServerRequest* request) {
  request->send(200, "text/plain", "Welcome to ESP32 B");
}

void handleDisplayMessage(AsyncWebServerRequest* request) {
  if (request->hasParam("message", true)) {
    message = request->getParam("message", true)->value();
    Serial.print("Received message: ");
    Serial.println(message);
    messageLength = message.length();
    currentPosition = 0;
  }
  request->redirect("/");
}

volatile bool sensorTriggered = false;  // Flag to indicate the hall effect sensor detection

void IRAM_ATTR hallEffectISR() {
  sensorTriggered = true;  // Set the flag to true when the hall effect sensor is triggered
}


void printCharacter(int characterData[][16])
{

  int startLedIndex = 7; // Starting LED index for displaying the letters
  int numLeds = 16; // Number of LEDs to use for displaying the letters

  for(int k=0; k<10; k++)
  {

      for (int i = 0; i < 16; i++)
    {

      for (int j = 0; j < NUM_PIXELS; j++)
      {

        if (j >= startLedIndex && j < startLedIndex + numLeds)
        {

          int ledIndex = j - startLedIndex;
          if (ledIndex < numLeds)
          {

            if (characterData[i][ledIndex] == 1)
            {

              leds[j] = CRGB::Red; // Set the LED color to Red or any desired color

            }
            else
            {
              leds[j] = CRGB::Black; // Set the LED color to Black (off)
            }
          }
        }
        else
        {
          leds[j] = CRGB::Black; // Set the LEDs before startLedIndex and after the display range to Black (off)
        }
      }

      FastLED.show();

      delay(2);
    }

    delay(8);
  }


  for (int i = 0; i < 16; i++)
  {
    for (int j = 0; j < NUM_PIXELS; j++)
    {
      if (j >= startLedIndex && j < startLedIndex + numLeds)
      {
        int ledIndex = j - startLedIndex;
        if (ledIndex < numLeds)
        {
          if (characterData[i][ledIndex] == 1)
          {
            leds[j] = CRGB::Black; // Set the LED color to Red or any desired color
          }
          else
          {
            leds[j] = CRGB::Black; // Set the LED color to Black (off)
          }
        }
      }
      else
      {
        leds[j] = CRGB::Black; // Set the LEDs before startLedIndex and after the display range to Black (off)
      }
    }

    FastLED.show();

    delay(2);

  }

  delay(8);

}


void textPrint(char currentChar)
{

  switch (currentChar) 
  {

    case 'a':
    case 'A':
      printCharacter(aData);
      break;

    delay(wait);

    case 'b':
    case 'B':
      printCharacter(bData);
      break;
    delay(wait);

    case 'c':
    case 'C':
      printCharacter(cData);
      break;
    delay(wait);

    case 'd':
    case 'D':
      printCharacter(dData);
      break;
    delay(wait);

    case 'e':
    case 'E':
      printCharacter(eData);
      break;
    delay(wait);

    case 'f':
    case 'F':
      printCharacter(fData);
      break;
    delay(wait);

    case 'g':
    case 'G':
      printCharacter(gData);
      break;
    delay(wait);

    case 'h':
    case 'H':
      printCharacter(hData);
      break;
    delay(wait);

    case 'i':
    case 'I':
      printCharacter(iData);
      break;
    delay(wait);
    case 'j':

    case 'J':
      printCharacter(jData);
      break;
    delay(wait);

    case 'k':
    case 'K':
      printCharacter(kData);
      break;
    delay(wait);

    case 'l':
    case 'L':
      printCharacter(lData);
      break;
    delay(wait);

    case 'm':
    case 'M':
      printCharacter(mData);
      break;
    delay(wait);

    case 'n':
    case 'N':
      printCharacter(nData);
      break;
    delay(wait);

    case 'o':
    case 'O':
      printCharacter(oData);
      break;
    delay(wait);

    case 'p':
    case 'P':
      printCharacter(pData);
      break;
    delay(wait);

    case 'q':
    case 'Q':
      printCharacter(qData);
      break;
    delay(wait);

    case 'r':
    case 'R':
      printCharacter(rData);
      break;
    delay(wait);

    case 's':
    case 'S':
      printCharacter(sData);
      break;
    delay(wait);

    case 't':
    case 'T':
      printCharacter(tData);
      break;
    delay(wait);

    case 'u':
    case 'U':
      printCharacter(uData);
      break;
    delay(wait);

    case 'v':
    case 'V':
      printCharacter(vData);
      break;
    delay(wait);

    case 'w':
    case 'W':
      printCharacter(wData);
      break;
    delay(wait);

    case 'x':
    case 'X':
      printCharacter(xData);
      break;
    delay(wait);

    case 'y':
    case 'Y':
      printCharacter(yData);
      break;
    delay(wait);

    case 'z':
    case 'Z':
      printCharacter(zData);
      break;
    delay(wait);
    
    // case '1':
    //   printCharacter(a1Data);
    //   break;

    // case '2':
    //   printCharacter(a2Data);
    //   break;

    // case '3':
    //   printCharacter(a3Data);
    //   break;

    // case '4':
    //   printCharacter(a4Data);
    //   break;

    // case '5':
    //   printCharacter(a5Data);
    //   break;

    // case '6':
    //   printCharacter(a6Data);
    //   break;

    // case '7':
    //   printCharacter(a7Data);
    //   break;

    // case '8':
    //   printCharacter(a8Data);
    //   break;

    // case '9':
    //   printCharacter(a9Data);
    //   break;

    // case '0':
    //   printCharacter(a0Data);
    //   break;
    
    default:
      printCharacter(spData);
      break;
    delay(wait);

  }

}

void setup() 
{
  Serial.begin(115200);

  // Initialize LED strip
  FastLED.addLeds<WS2812B, DATA_PIN, GRB>(leds, NUM_PIXELS);
  FastLED.setBrightness(brightnessLevel);

  pinMode(hallEffectPin, INPUT_PULLUP);  // Use INPUT_PULLUP to enable the internal pull-up resistor
  attachInterrupt(digitalPinToInterrupt(hallEffectPin), hallEffectISR, FALLING);  // Attach the interrupt

  WiFi.begin(ssid, password);
  while (WiFi.status() != WL_CONNECTED) {
    delay(1000);
    Serial.println("Connecting to WiFi...");
  }
  Serial.println("Connected to WiFi");
  Serial.println();
  Serial.print("IP Address: ");
  Serial.println(WiFi.localIP());

  server.on("/", HTTP_GET, handleRoot);
  server.on("/displaymessage", HTTP_POST, handleDisplayMessage);

  server.begin();

  for (int i = 0; i < NUM_PIXELS; i++) {
    leds[i] = CRGB::White;  // Set all LEDs to on
  }
  FastLED.show();
  
}

void loop()
{

  if (message != "") 
  {

    if (sensorTriggered) 
    { 
      // Check if the hall effect sensor is triggered
      sensorTriggered = false;  // Reset the flag
      
      if (currentPosition >= messageLength) 
      {
      
        currentPosition = 0;  // Reset to the beginning of the message
        delay(800);  // Delay for 2 seconds before displaying the message again
  
      } 
      else if (currentPosition >= 0 && currentPosition < messageLength) 
      {
  
        char currentChar = message[currentPosition];
        textPrint(currentChar);  // Generate LED pattern for the current character
        delay(800);
        currentPosition++;
        //delay(100);  // Adjust the delay as needed to control the rotation speed
  
      } 
      else 
      {
  
        // Clear LEDs when the sensor is not active
        for (int i = 0; i < NUM_PIXELS; i++) 
        {
          leds[i] = CRGB::Black;  // Set all LEDs to off
        }
        FastLED.show();
  
      }
  
    }
  
  }

}