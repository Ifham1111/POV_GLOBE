#include <FastLED.h>
#include <WiFi.h>
#include <AsyncTCP.h>
#include <ESPAsyncWebServer.h>

const char* ssid = "G3";
const char* password = "12345678910";

// Pin configuration
const int DATA_PIN = 13;
const int NUM_PIXELS = 30;
int NUM_ROWS = 16;

byte hall = 0;

CRGB leds[NUM_PIXELS];

int brightnessLevel = 128;

int previousBrightnessLevel = brightnessLevel;


String message="";

int aData[16][16] = {
  {0, 0, 0, 0, 0, 0, 0, 0, 0, 0, 0, 0, 0, 0, 0, 0},
  {0, 0, 0, 0, 0, 0, 0, 0, 0, 0, 0, 0, 0, 0, 0, 0},
  {0, 0, 0, 0, 0, 0, 0, 0, 0, 0, 0, 0, 0, 0, 0, 0},
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  {0, 0, 1, 1, 1, 1, 1, 1, 1, 1, 1, 1, 1, 1, 1, 1}
};

int bData[16][16] = {
  {0, 0, 0, 0, 0, 0, 0, 0, 0, 0, 0, 0, 0, 0, 0, 0},
  {0, 0, 0, 0, 0, 0, 0, 0, 0, 0, 0, 0, 0, 0, 0, 0},
  {0, 0, 0, 0, 0, 0, 0, 0, 0, 0, 0, 0, 0, 0, 0, 0},
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  {1, 1, 1, 1, 1, 1, 1, 1, 1, 1, 1, 1, 1, 1, 1, 1}


};

int cData[16][16] = {
  {0, 0, 0, 0, 0, 0, 0, 0, 0, 0, 0, 0, 0, 0, 0, 0},
  {0, 0, 0, 0, 0, 0, 0, 0, 0, 0, 0, 0, 0, 0, 0, 0},
  {0, 0, 0, 0, 0, 0, 0, 0, 0, 0, 0, 0, 0, 0, 0, 0},
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  {0, 0, 0, 1, 1, 1, 1, 1, 1, 1, 1, 1, 1, 0, 0, 0}
};

int dData[16][16] = {
  {0, 0, 0, 0, 0, 0, 0, 0, 0, 0, 0, 0, 0, 0, 0, 0},
  {0, 0, 0, 0, 0, 0, 0, 0, 0, 0, 0, 0, 0, 0, 0, 0},
  {0, 0, 0, 0, 0, 0, 0, 0, 0, 0, 0, 0, 0, 0, 0, 0},
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  {1, 1, 1, 1, 1, 1, 1, 1, 1, 1, 1, 1, 1, 1, 1, 1}
};

int eData[16][16] = {
  {0, 0, 0, 0, 0, 0, 0, 0, 0, 0, 0, 0, 0, 0, 0, 0},
  {0, 0, 0, 0, 0, 0, 0, 0, 0, 0, 0, 0, 0, 0, 0, 0},
  {0, 0, 0, 0, 0, 0, 0, 0, 0, 0, 0, 0, 0, 0, 0, 0},
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  {1, 1, 1, 1, 1, 1, 1, 1, 1, 1, 1, 1, 1, 1, 1, 1}
};

int fData[16][16] = {
  {0, 0, 0, 0, 0, 0, 0, 0, 0, 0, 0, 0, 0, 0, 0, 0},
  {0, 0, 0, 0, 0, 0, 0, 0, 0, 0, 0, 0, 0, 0, 0, 0},
  {0, 0, 0, 0, 0, 0, 0, 0, 0, 0, 0, 0, 0, 0, 0, 0},
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  {1, 1, 1, 1, 1, 1, 1, 1, 1, 1, 1, 1, 1, 1, 1, 1}
};

int gData[16][16] = {
  {0, 0, 0, 0, 0, 0, 0, 0, 0, 0, 0, 0, 0, 0, 0, 0},
  {0, 0, 0, 0, 0, 0, 0, 0, 0, 0, 0, 0, 0, 0, 0, 0},
  {0, 0, 0, 0, 0, 0, 0, 0, 0, 0, 0, 0, 0, 0, 0, 0},
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  {1, 1, 1, 1, 1, 1, 1, 1, 1, 1, 1, 1, 1, 1, 1, 1}
};

int hData[16][16] = {
  {0, 0, 0, 0, 0, 0, 0, 0, 0, 0, 0, 0, 0, 0, 0, 0},
  {0, 0, 0, 0, 0, 0, 0, 0, 0, 0, 0, 0, 0, 0, 0, 0},
  {0, 0, 0, 0, 0, 0, 0, 0, 0, 0, 0, 0, 0, 0, 0, 0},
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  {1, 1, 1, 1, 1, 1, 1, 1, 1, 1, 1, 1, 1, 1, 1, 1}
};

int iData[16][16] = {
  {0, 0, 0, 0, 0, 0, 0, 0, 0, 0, 0, 0, 0, 0, 0, 0},
  {0, 0, 0, 0, 0, 0, 0, 0, 0, 0, 0, 0, 0, 0, 0, 0},
  {0, 0, 0, 0, 0, 0, 0, 0, 0, 0, 0, 0, 0, 0, 0, 0},
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  {1, 1, 1, 0, 0, 0, 0, 0, 0, 0, 0, 0, 0, 1, 1, 1}
};

int jData[16][16] = {
  {0, 0, 0, 0, 0, 0, 0, 0, 0, 0, 0, 0, 0, 0, 0, 0},
  {0, 0, 0, 0, 0, 0, 0, 0, 0, 0, 0, 0, 0, 0, 0, 0},
  {0, 0, 0, 0, 0, 0, 0, 0, 0, 0, 0, 0, 0, 0, 0, 0},
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  {1, 1, 1, 0, 0, 0, 0, 0, 0, 0, 0, 1, 1, 1, 1, 0}
};

int kData[16][16] = {
  {0, 0, 0, 0, 0, 0, 0, 0, 0, 0, 0, 0, 0, 0, 0, 0},
  {0, 0, 0, 0, 0, 0, 0, 0, 0, 0, 0, 0, 0, 0, 0, 0},
  {0, 0, 0, 0, 0, 0, 0, 0, 0, 0, 0, 0, 0, 0, 0, 0},
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  {1, 1, 1, 1, 1, 1, 1, 1, 1, 1, 1, 1, 1, 1, 1, 1}
};


int lData[16][16] = {
  {0, 0, 0, 0, 0, 0, 0, 0, 0, 0, 0, 0, 0, 0, 0, 0},
  {0, 0, 0, 0, 0, 0, 0, 0, 0, 0, 0, 0, 0, 0, 0, 0},
  {0, 0, 0, 0, 0, 0, 0, 0, 0, 0, 0, 0, 0, 0, 0, 0},
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  {1, 1, 1, 1, 1, 1, 1, 1, 1, 1, 1, 1, 1, 1, 1, 1}
};

int mData[16][16] = {
  {0, 0, 0, 0, 0, 0, 0, 0, 0, 0, 0, 0, 0, 0, 0, 0},
  {0, 0, 0, 0, 0, 0, 0, 0, 0, 0, 0, 0, 0, 0, 0, 0},
  {0, 0, 0, 0, 0, 0, 0, 0, 0, 0, 0, 0, 0, 0, 0, 0},
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  {1, 1, 1, 1, 1, 1, 1, 1, 1, 1, 1, 1, 1, 1, 1, 1}
};


int nData[16][16] = {
  {0, 0, 0, 0, 0, 0, 0, 0, 0, 0, 0, 0, 0, 0, 0, 0},
  {0, 0, 0, 0, 0, 0, 0, 0, 0, 0, 0, 0, 0, 0, 0, 0},
  {0, 0, 0, 0, 0, 0, 0, 0, 0, 0, 0, 0, 0, 0, 0, 0},
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  {1, 1, 1, 1, 1, 1, 1, 1, 1, 1, 1, 1, 1, 1, 1, 1}
};

int oData[16][16] = {
  {0, 0, 0, 0, 0, 0, 0, 0, 0, 0, 0, 0, 0, 0, 0, 0},
  {0, 0, 0, 0, 0, 0, 0, 0, 0, 0, 0, 0, 0, 0, 0, 0},
  {0, 0, 0, 0, 0, 0, 0, 0, 0, 0, 0, 0, 0, 0, 0, 0},
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  {0, 0, 0, 1, 1, 1, 1, 1, 1, 1, 1, 1, 1, 0, 0, 0}
};


int pData[16][16] = {
  {0, 0, 0, 0, 0, 0, 0, 0, 0, 0, 0, 0, 0, 0, 0, 0},
  {0, 0, 0, 0, 0, 0, 0, 0, 0, 0, 0, 0, 0, 0, 0, 0},
  {0, 0, 0, 0, 0, 0, 0, 0, 0, 0, 0, 0, 0, 0, 0, 0},
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  {1, 1, 1, 1, 1, 1, 1, 1, 1, 1, 1, 1, 1, 1, 1, 1}
};


int qData[16][16] = {
  {0, 0, 0, 0, 0, 0, 0, 0, 0, 0, 0, 0, 0, 0, 0, 0},
  {0, 0, 0, 0, 0, 0, 0, 0, 0, 0, 0, 0, 0, 0, 0, 0},
  {0, 0, 0, 0, 0, 0, 0, 0, 0, 0, 0, 0, 0, 0, 0, 0},
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  {0, 0, 1, 1, 1, 1, 1, 1, 1, 1, 1, 1, 1, 1, 0, 0}
};


int rData[16][16] = {
  {0, 0, 0, 0, 0, 0, 0, 0, 0, 0, 0, 0, 0, 0, 0, 0},
  {0, 0, 0, 0, 0, 0, 0, 0, 0, 0, 0, 0, 0, 0, 0, 0},
  {0, 0, 0, 0, 0, 0, 0, 0, 0, 0, 0, 0, 0, 0, 0, 0},
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  {1, 1, 1, 1, 1, 1, 1, 1, 1, 1, 1, 1, 1, 1, 1, 1}
};


int sData[16][16] = {
  {0, 0, 0, 0, 0, 0, 0, 0, 0, 0, 0, 0, 0, 0, 0, 0},
  {0, 0, 0, 0, 0, 0, 0, 0, 0, 0, 0, 0, 0, 0, 0, 0},
  {0, 0, 0, 0, 0, 0, 0, 0, 0, 0, 0, 0, 0, 0, 0, 0},
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  {0, 0, 1, 1, 1, 1, 0, 0, 0, 0, 0, 0, 0, 1, 1, 1}
};

int tData[16][16] = {

  {0, 0, 0, 0, 0, 0, 0, 0, 0, 0, 0, 0, 0, 0, 0, 0},
  {0, 0, 0, 0, 0, 0, 0, 0, 0, 0, 0, 0, 0, 0, 0, 0},
  {0, 0, 0, 0, 0, 0, 0, 0, 0, 0, 0, 0, 0, 0, 0, 0},
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  {1, 1, 0, 0, 0, 0, 0, 0, 0, 0, 0, 0, 0, 0, 0, 0}
};

int uData[16][16] = {
  {0, 0, 0, 0, 0, 0, 0, 0, 0, 0, 0, 0, 0, 0, 0, 0},
  {0, 0, 0, 0, 0, 0, 0, 0, 0, 0, 0, 0, 0, 0, 0, 0},
  {0, 0, 0, 0, 0, 0, 0, 0, 0, 0, 0, 0, 0, 0, 0, 0},
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  {1, 1, 1, 1, 1, 1, 1, 1, 1, 1, 1, 1, 1, 0, 0, 0}
};


int vData[16][16] = {
  {0, 0, 0, 0, 0, 0, 0, 0, 0, 0, 0, 0, 0, 0, 0, 0},
  {0, 0, 0, 0, 0, 0, 0, 0, 0, 0, 0, 0, 0, 0, 0, 0},
  {0, 0, 0, 0, 0, 0, 0, 0, 0, 0, 0, 0, 0, 0, 0, 0},
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  {1, 1, 1, 1, 1, 1, 1, 1, 1, 1, 1, 0, 0, 0, 0, 0}
};

int wData[16][16] = {
  {0, 0, 0, 0, 0, 0, 0, 0, 0, 0, 0, 0, 0, 0, 0, 0},
  {0, 0, 0, 0, 0, 0, 0, 0, 0, 0, 0, 0, 0, 0, 0, 0},
  {0, 0, 0, 0, 0, 0, 0, 0, 0, 0, 0, 0, 0, 0, 0, 0},
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  {1, 1, 1, 1, 1, 1, 1, 1, 1, 1, 1, 1, 1, 1, 1, 1}
};

int xData[16][16] = {
  {0, 0, 0, 0, 0, 0, 0, 0, 0, 0, 0, 0, 0, 0, 0, 0},
  {0, 0, 0, 0, 0, 0, 0, 0, 0, 0, 0, 0, 0, 0, 0, 0},
  {0, 0, 0, 0, 0, 0, 0, 0, 0, 0, 0, 0, 0, 0, 0, 0},
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  {1, 1, 1, 0, 0, 0, 0, 0, 0, 0, 0, 0, 0, 1, 1, 1}
};

int yData[16][16] = {
  {0, 0, 0, 0, 0, 0, 0, 0, 0, 0, 0, 0, 0, 0, 0, 0},
  {0, 0, 0, 0, 0, 0, 0, 0, 0, 0, 0, 0, 0, 0, 0, 0},
  {0, 0, 0, 0, 0, 0, 0, 0, 0, 0, 0, 0, 0, 0, 0, 0},
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  {1, 1, 1, 0, 0, 0, 0, 0, 0, 0, 0, 0, 0, 0, 0, 0}
};


int zData[16][16] = {
  {0, 0, 0, 0, 0, 0, 0, 0, 0, 0, 0, 0, 0, 0, 0, 0},
  {0, 0, 0, 0, 0, 0, 0, 0, 0, 0, 0, 0, 0, 0, 0, 0},
  {0, 0, 0, 0, 0, 0, 0, 0, 0, 0, 0, 0, 0, 0, 0, 0},
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  {1, 1, 1, 0, 0, 0, 0, 0, 0, 0, 1, 1, 1, 1, 1, 1}
};

int spData[16][16] = {
  {0, 0, 0, 0, 0, 0, 0, 0, 0, 0, 0, 0, 0, 0, 0, 0},
  {0, 0, 0, 0, 0, 0, 0, 0, 0, 0, 0, 0, 0, 0, 0, 0},
  {0, 0, 0, 0, 0, 0, 0, 0, 0, 0, 0, 0, 0, 0, 0, 0},
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  {0, 0, 0, 0, 0, 0, 0, 0, 0, 0, 0, 0, 0, 0, 0, 0}
};

AsyncWebServer server(80);

void handleRoot(AsyncWebServerRequest* request) {
  request->send(200, "text/plain", "Welcome to ESP32 B");
}

void handleDisplayMessage(AsyncWebServerRequest* request) {
  if (request->hasParam("message", true)) {
    message = request->getParam("message", true)->value();
    Serial.print("Received message: ");
    Serial.println(message);
  }
  request->redirect("/");
}

// void handleLedBrigthness(AsyncWebServerRequest* request) {
//   if (request->hasParam("brightness", true)) {
//     String brightnessLevel = request->getParam("brightness", true)->value();
//     Serial.print("Received message: ");
//     Serial.println(brightnessLevel);

//     lcd.clear();
//     lcd.print("Message:");
//     lcd.setCursor(0, 0);
//     lcd.print(brightnessLevel);
//     delay(2000);
//   }

//   request->redirect("/");
// }


void setup() {
  Serial.begin(115200);

  // Initialize LED strip
  FastLED.addLeds<WS2812B, DATA_PIN, GRB>(leds, NUM_PIXELS);
  FastLED.setBrightness(brightnessLevel);

  attachInterrupt(14, LEDiyak, RISING);


  WiFi.begin(ssid, password);
  while (WiFi.status() != WL_CONNECTED) {
    delay(1000);
    Serial.println("Connecting to WiFi...");
  }
  Serial.println("Connected to WiFi");
  Serial.println();
  Serial.print("IP Address: ");
  Serial.println(WiFi.localIP());

  

  server.on("/", HTTP_GET, handleRoot);
  server.on("/displaymessage", HTTP_POST, handleDisplayMessage);
  //server.on("/displaybrightnessLevel", HTTP_POST, handleLedBrigthness);

  server.begin();

}

void LEDiyak()
{
 hall++;
  Serial.println("kesme");
  if(hall>2)
  {hall=0;}
}

void loop()
{
  if (message != "") {

    if(hall >0)
    {
      textprint();
      hall = 0;
    }

  }

}


// void printCharacter(int characterData[][16]) 
// {

//   Serial.println("21");
  
//   for (int i = 0; i < 16; i++) 
//   {
  
//     for (int j = 0; j < NUM_PIXELS; j++) 
//     {
    
//       if (characterData[i][j] == 1) 
//       {
//         leds[j] = CRGB::Red;
//       } 
//       else 
//       {
//         leds[j] = CRGB::Black;
//       }
    
//     }
    
//     FastLED.show();
    
//     delay(2);
//   }
  
//   delay(8);

// }

// void printCharacter(int characterData[][16])
// {
//   Serial.println("21");

//   for (int i = 0; i < 16; i++)
//   {
//     for (int j = 0; j < NUM_PIXELS; j++)
//     {
//       if (characterData[i][j] == 1)
//       {
//         // Set the first 7 LEDs pattern
//         if (j < 7)
//         {
//           int rotatedIndex = (j + 2) % 7; // Rotate the LED index by 2
//           leds[rotatedIndex] = CRGB::Red;
//         }
//         // Set the last 7 LEDs pattern
//         else if (j >= NUM_PIXELS - 7)
//         {
//           int mirroredIndex = NUM_PIXELS - 1 - (j - (NUM_PIXELS - 7)); // Mirror the LED index
//           leds[mirroredIndex] = CRGB::Red;
//         }
//         // Set the remaining LEDs to Black
//         else
//         {
//           leds[j] = CRGB::Black;
//         }
//       }
//       else
//       {
//         leds[j] = CRGB::Black;
//       }
//     }

//     FastLED.show();
//     delay(2);
//   }

//   delay(8);
// }

// void printCharacter(int characterData[][16])
// {
//   Serial.println("21");

//   // Define the beautiful design pattern for the first 7 LEDs
//   int beautifulPattern[] = {1, 0, 1, 0, 1, 0, 1}; // Example pattern, modify as desired

//   // Display the beautiful design pattern on the first 7 LEDs
//   for (int i = 0; i < 7; i++)
//   {
//     leds[i] = beautifulPattern[i] ? CRGB::Red : CRGB::Black;
//   }
//   FastLED.show();
//   delay(1000); // Adjust the delay to control the duration of the beautiful pattern

//   // Display the letter pattern on the 16 LEDs
//   for (int i = 0; i < 16; i++)
//   {
//     for (int j = 0; j < NUM_PIXELS; j++)
//     {
//       if (characterData[i][j] == 1)
//       {
//         leds[j + 7] = CRGB::Green; // Use any desired RGB color for the letter pattern
//       }
//       else
//       {
//         leds[j + 7] = CRGB::Black;
//       }
//     }
//     FastLED.show();
//     delay(2);
//   }

//   // Mirror the beautiful design pattern for the last 7 LEDs
//   for (int i = 0; i < 7; i++)
//   {
//     leds[NUM_PIXELS - 7 + i] = beautifulPattern[6 - i] ? CRGB::Red : CRGB::Black;
//   }
//   FastLED.show();
//   delay(1000); // Adjust the delay to control the duration of the mirrored pattern

//   delay(8);
// }

void printCharacter(int characterData[][16])
{
  Serial.println("21");

  int startLedIndex = 7; // Starting LED index for displaying the letters
  int numLeds = 16; // Number of LEDs to use for displaying the letters

  for (int i = 0; i < 16; i++)
  {
    for (int j = 0; j < NUM_PIXELS; j++)
    {
      if (j >= startLedIndex && j < startLedIndex + numLeds)
      {
        int ledIndex = j - startLedIndex;
        if (ledIndex < numLeds)
        {
          if (characterData[i][ledIndex] == 1)
          {
            leds[j] = CRGB::Red; // Set the LED color to Red or any desired color
          }
          else
          {
            leds[j] = CRGB::Black; // Set the LED color to Black (off)
          }
        }
      }
      else
      {
        leds[j] = CRGB::Black; // Set the LEDs before startLedIndex and after the display range to Black (off)
      }
    }

    FastLED.show();

    delay(2);
  }

  delay(8);
}



void textprint()
{
  for (int i = 0; i < message.length(); i++)
    {
      char current_char = message.charAt(i);

      switch (current_char) {
      case 'a':
      case 'A':
        printCharacter(aData);
        break;

      delay(8);

      case 'b':
      case 'B':
        printCharacter(bData);
        break;
      delay(8);

      case 'c':
      case 'C':
        printCharacter(cData);
        break;
      delay(8);

      case 'd':
      case 'D':
        printCharacter(dData);
        break;
      delay(8);

      case 'e':
      case 'E':
        printCharacter(eData);
        break;
      delay(8);

      case 'f':
      case 'F':
        printCharacter(fData);
        break;
      delay(8);

      case 'g':
      case 'G':
        printCharacter(gData);
        break;
      delay(8);

      case 'h':
      case 'H':
        printCharacter(hData);
        break;
      delay(8);

      case 'i':
      case 'I':
        printCharacter(iData);
        break;
      delay(8);
      case 'j':

      case 'J':
        printCharacter(jData);
        break;
      delay(8);

      case 'k':
      case 'K':
        printCharacter(kData);
        break;
      delay(8);

      case 'l':
      case 'L':
        printCharacter(lData);
        break;
      delay(8);

      case 'm':
      case 'M':
        printCharacter(mData);
        break;
      delay(8);

      case 'n':
      case 'N':
        printCharacter(nData);
        break;
      delay(8);

      case 'o':
      case 'O':
        printCharacter(oData);
        break;
      delay(8);

      case 'p':
      case 'P':
        printCharacter(pData);
        break;
      delay(8);

      case 'q':
      case 'Q':
        printCharacter(qData);
        break;
      delay(8);

      case 'r':
      case 'R':
        printCharacter(rData);
        break;
      delay(8);

      case 's':
      case 'S':
        printCharacter(sData);
        break;
      delay(8);

      case 't':
      case 'T':
        printCharacter(tData);
        break;
      delay(8);

      case 'u':
      case 'U':
        printCharacter(uData);
        break;
      delay(8);

      case 'v':
      case 'V':
        printCharacter(vData);
        break;
      delay(8);

      case 'w':
      case 'W':
        printCharacter(wData);
        break;
      delay(8);

      case 'x':
      case 'X':
        printCharacter(xData);
        break;
      delay(8);

      case 'y':
      case 'Y':
        printCharacter(yData);
        break;
      delay(8);

      case 'z':
      case 'Z':
        printCharacter(zData);
        break;
      delay(8);
      
      // case '1':
      //   printCharacter(a1Data);
      //   break;

      // case '2':
      //   printCharacter(a2Data);
      //   break;

      // case '3':
      //   printCharacter(a3Data);
      //   break;

      // case '4':
      //   printCharacter(a4Data);
      //   break;

      // case '5':
      //   printCharacter(a5Data);
      //   break;

      // case '6':
      //   printCharacter(a6Data);
      //   break;

      // case '7':
      //   printCharacter(a7Data);
      //   break;

      // case '8':
      //   printCharacter(a8Data);
      //   break;

      // case '9':
      //   printCharacter(a9Data);
      //   break;

      // case '0':
      //   printCharacter(a0Data);
      //   break;
      
      default:
        printCharacter(spData);
        break;
      }

  }
}